## twister_qemu_riscv32_no_multithreading_llvm_cov_cpullvm_22_eld/qemu_riscv32_qemu_virt_riscv32/host_llvm/tests/kernel/threads/no-multithreading/kernel.threads.no-multithreading/Kconfig/soc/Kconfig.sysbuild
```kconfig
# Load Sysbuild SoC Kconfig descriptions.
osource "/local/mnt/workspace/vede/zephyr/zephyr-fork/zephyr/soc/xlnx/zynqmp/Kconfig.sysbuild"
osource "/local/mnt/workspace/vede/zephyr/zephyr-fork/zephyr/soc/xlnx/zynq7000/Kconfig.sysbuild"
osource "/local/mnt/workspace/vede/zephyr/zephyr-fork/zephyr/soc/xlnx/versalnet/Kconfig.sysbuild"
osource "/local/mnt/workspace/vede/zephyr/zephyr-fork/zephyr/soc/xlnx/versal2/Kconfig.sysbuild"
osource "/local/mnt/workspace/vede/zephyr/zephyr-fork/zephyr/soc/xlnx/versal/Kconfig.sysbuild"
osource "/local/mnt/workspace/vede/zephyr/zephyr-fork/zephyr/soc/xen/Kconfig.sysbuild"
osource "/local/mnt/workspace/vede/zephyr/zephyr-fork/zephyr/soc/wch/ch32v/Kconfig.sysbuild"
osource "/local/mnt/workspace/vede/zephyr/zephyr-fork/zephyr/soc/ti/tiva_c/Kconfig.sysbuild"
osource "/local/mnt/workspace/vede/zephyr/zephyr-fork/zephyr/soc/ti/simplelink/Kconfig.sysbuild"
osource "/local/mnt/workspace/vede/zephyr/zephyr-fork/zephyr/soc/ti/mspm/Kconfig.sysbuild"
osource "/local/mnt/workspace/vede/zephyr/zephyr-fork/zephyr/soc/ti/lm3s6965/Kconfig.sysbuild"
osource "/local/mnt/workspace/vede/zephyr/zephyr-fork/zephyr/soc/ti/k3/Kconfig.sysbuild"
osource "/local/mnt/workspace/vede/zephyr/zephyr-fork/zephyr/soc/ti/am13/Kconfig.sysbuild"
osource "/local/mnt/workspace/vede/zephyr/zephyr-fork/zephyr/soc/telink/tlsr/Kconfig.sysbuild"
osource "/local/mnt/workspace/vede/zephyr/zephyr-fork/zephyr/soc/syna/sr100/Kconfig.sysbuild"
osource "/local/mnt/workspace/vede/zephyr/zephyr-fork/zephyr/soc/starfive/jh71xx/Kconfig.sysbuild"
osource "/local/mnt/workspace/vede/zephyr/zephyr-fork/zephyr/soc/st/stm32/Kconfig.sysbuild"
osource "/local/mnt/workspace/vede/zephyr/zephyr-fork/zephyr/soc/snps/qemu_arc/Kconfig.sysbuild"
osource "/local/mnt/workspace/vede/zephyr/zephyr-fork/zephyr/soc/snps/nsim/arc_v/Kconfig.sysbuild"
osource "/local/mnt/workspace/vede/zephyr/zephyr-fork/zephyr/soc/snps/nsim/arc_classic/Kconfig.sysbuild"
osource "/local/mnt/workspace/vede/zephyr/zephyr-fork/zephyr/soc/snps/hsdk4xd/Kconfig.sysbuild"
osource "/local/mnt/workspace/vede/zephyr/zephyr-fork/zephyr/soc/snps/hsdk/Kconfig.sysbuild"
osource "/local/mnt/workspace/vede/zephyr/zephyr-fork/zephyr/soc/snps/emsk/Kconfig.sysbuild"
osource "/local/mnt/workspace/vede/zephyr/zephyr-fork/zephyr/soc/snps/emsdp/Kconfig.sysbuild"
osource "/local/mnt/workspace/vede/zephyr/zephyr-fork/zephyr/soc/snps/arc_iot/Kconfig.sysbuild"
osource "/local/mnt/workspace/vede/zephyr/zephyr-fork/zephyr/soc/silabs/Kconfig.sysbuild"
osource "/local/mnt/workspace/vede/zephyr/zephyr-fork/zephyr/soc/sifli/sf32/Kconfig.sysbuild"
osource "/local/mnt/workspace/vede/zephyr/zephyr-fork/zephyr/soc/sifive/sifive_freedom/Kconfig.sysbuild"
osource "/local/mnt/workspace/vede/zephyr/zephyr-fork/zephyr/soc/shakti/Kconfig.sysbuild"
osource "/local/mnt/workspace/vede/zephyr/zephyr-fork/zephyr/soc/sensry/Kconfig.sysbuild"
osource "/local/mnt/workspace/vede/zephyr/zephyr-fork/zephyr/soc/rockchip/Kconfig.sysbuild"
osource "/local/mnt/workspace/vede/zephyr/zephyr-fork/zephyr/soc/renode/riscv_virtual/Kconfig.sysbuild"
osource "/local/mnt/workspace/vede/zephyr/zephyr-fork/zephyr/soc/renode/cortex_r8_virtual/Kconfig.sysbuild"
osource "/local/mnt/workspace/vede/zephyr/zephyr-fork/zephyr/soc/renesas/smartbond/Kconfig.sysbuild"
osource "/local/mnt/workspace/vede/zephyr/zephyr-fork/zephyr/soc/renesas/rz/Kconfig.sysbuild"
osource "/local/mnt/workspace/vede/zephyr/zephyr-fork/zephyr/soc/renesas/rx/Kconfig.sysbuild"
osource "/local/mnt/workspace/vede/zephyr/zephyr-fork/zephyr/soc/renesas/rcar/Kconfig.sysbuild"
osource "/local/mnt/workspace/vede/zephyr/zephyr-fork/zephyr/soc/renesas/ra/Kconfig.sysbuild"
osource "/local/mnt/workspace/vede/zephyr/zephyr-fork/zephyr/soc/realtek/fingerprint/Kconfig.sysbuild"
osource "/local/mnt/workspace/vede/zephyr/zephyr-fork/zephyr/soc/realtek/ec/Kconfig.sysbuild"
osource "/local/mnt/workspace/vede/zephyr/zephyr-fork/zephyr/soc/realtek/bee/Kconfig.sysbuild"
osource "/local/mnt/workspace/vede/zephyr/zephyr-fork/zephyr/soc/realtek/ameba/Kconfig.sysbuild"
osource "/local/mnt/workspace/vede/zephyr/zephyr-fork/zephyr/soc/raspberrypi/rpi_pico/Kconfig.sysbuild"
osource "/local/mnt/workspace/vede/zephyr/zephyr-fork/zephyr/soc/quicklogic/eos_s3/Kconfig.sysbuild"
osource "/local/mnt/workspace/vede/zephyr/zephyr-fork/zephyr/soc/qemu/virt_riscv/Kconfig.sysbuild"
osource "/local/mnt/workspace/vede/zephyr/zephyr-fork/zephyr/soc/qemu/or1k/Kconfig.sysbuild"
osource "/local/mnt/workspace/vede/zephyr/zephyr-fork/zephyr/soc/qemu/malta/Kconfig.sysbuild"
osource "/local/mnt/workspace/vede/zephyr/zephyr-fork/zephyr/soc/openisa/rv32m1/Kconfig.sysbuild"
osource "/local/mnt/workspace/vede/zephyr/zephyr-fork/zephyr/soc/openhwgroup/cva6/Kconfig.sysbuild"
osource "/local/mnt/workspace/vede/zephyr/zephyr-fork/zephyr/soc/oct/osd32mp15x/Kconfig.sysbuild"
osource "/local/mnt/workspace/vede/zephyr/zephyr-fork/zephyr/soc/nxp/s32/Kconfig.sysbuild"
osource "/local/mnt/workspace/vede/zephyr/zephyr-fork/zephyr/soc/nxp/rw/Kconfig.sysbuild"
osource "/local/mnt/workspace/vede/zephyr/zephyr-fork/zephyr/soc/nxp/mcx/Kconfig.sysbuild"
osource "/local/mnt/workspace/vede/zephyr/zephyr-fork/zephyr/soc/nxp/lpc/Kconfig.sysbuild"
osource "/local/mnt/workspace/vede/zephyr/zephyr-fork/zephyr/soc/nxp/layerscape/Kconfig.sysbuild"
osource "/local/mnt/workspace/vede/zephyr/zephyr-fork/zephyr/soc/nxp/kinetis/Kconfig.sysbuild"
osource "/local/mnt/workspace/vede/zephyr/zephyr-fork/zephyr/soc/nxp/imxrt/Kconfig.sysbuild"
osource "/local/mnt/workspace/vede/zephyr/zephyr-fork/zephyr/soc/nxp/imx/Kconfig.sysbuild"
osource "/local/mnt/workspace/vede/zephyr/zephyr-fork/zephyr/soc/nuvoton/numicro/Kconfig.sysbuild"
osource "/local/mnt/workspace/vede/zephyr/zephyr-fork/zephyr/soc/nuvoton/numaker/Kconfig.sysbuild"
osource "/local/mnt/workspace/vede/zephyr/zephyr-fork/zephyr/soc/nuvoton/npcx/Kconfig.sysbuild"
osource "/local/mnt/workspace/vede/zephyr/zephyr-fork/zephyr/soc/nuvoton/npcm/Kconfig.sysbuild"
osource "/local/mnt/workspace/vede/zephyr/zephyr-fork/zephyr/soc/nordic/Kconfig.sysbuild"
osource "/local/mnt/workspace/vede/zephyr/zephyr-fork/zephyr/soc/neorv32/Kconfig.sysbuild"
osource "/local/mnt/workspace/vede/zephyr/zephyr-fork/zephyr/soc/native/inf_clock/Kconfig.sysbuild"
osource "/local/mnt/workspace/vede/zephyr/zephyr-fork/zephyr/soc/microchip/smartfusion2/Kconfig.sysbuild"
osource "/local/mnt/workspace/vede/zephyr/zephyr-fork/zephyr/soc/microchip/sam/sama7/Kconfig.sysbuild"
osource "/local/mnt/workspace/vede/zephyr/zephyr-fork/zephyr/soc/microchip/sam/sama5/Kconfig.sysbuild"
osource "/local/mnt/workspace/vede/zephyr/zephyr-fork/zephyr/soc/microchip/sam/sam_d5x_e5x/Kconfig.sysbuild"
osource "/local/mnt/workspace/vede/zephyr/zephyr-fork/zephyr/soc/microchip/pic64/Kconfig.sysbuild"
osource "/local/mnt/workspace/vede/zephyr/zephyr-fork/zephyr/soc/microchip/pic32c/pic32cz_ca/Kconfig.sysbuild"
osource "/local/mnt/workspace/vede/zephyr/zephyr-fork/zephyr/soc/microchip/pic32c/pic32cx_sg/Kconfig.sysbuild"
osource "/local/mnt/workspace/vede/zephyr/zephyr-fork/zephyr/soc/microchip/pic32c/pic32cm_sg_gc/Kconfig.sysbuild"
osource "/local/mnt/workspace/vede/zephyr/zephyr-fork/zephyr/soc/microchip/pic32c/pic32cm_pl/Kconfig.sysbuild"
osource "/local/mnt/workspace/vede/zephyr/zephyr-fork/zephyr/soc/microchip/pic32c/pic32cm_jh/Kconfig.sysbuild"
osource "/local/mnt/workspace/vede/zephyr/zephyr-fork/zephyr/soc/microchip/pic32c/pic32ck_sg_gc/Kconfig.sysbuild"
osource "/local/mnt/workspace/vede/zephyr/zephyr-fork/zephyr/soc/microchip/miv/Kconfig.sysbuild"
osource "/local/mnt/workspace/vede/zephyr/zephyr-fork/zephyr/soc/microchip/mec/Kconfig.sysbuild"
osource "/local/mnt/workspace/vede/zephyr/zephyr-fork/zephyr/soc/mediatek/mt8xxx/Kconfig.sysbuild"
osource "/local/mnt/workspace/vede/zephyr/zephyr-fork/zephyr/soc/lowrisc/opentitan/Kconfig.sysbuild"
osource "/local/mnt/workspace/vede/zephyr/zephyr-fork/zephyr/soc/litex/Kconfig.sysbuild"
osource "/local/mnt/workspace/vede/zephyr/zephyr-fork/zephyr/soc/ite/ec/Kconfig.sysbuild"
osource "/local/mnt/workspace/vede/zephyr/zephyr-fork/zephyr/soc/intel/wildcat_lake/Kconfig.sysbuild"
osource "/local/mnt/workspace/vede/zephyr/zephyr-fork/zephyr/soc/intel/raptor_lake/Kconfig.sysbuild"
osource "/local/mnt/workspace/vede/zephyr/zephyr-fork/zephyr/soc/intel/panther_lake/Kconfig.sysbuild"
osource "/local/mnt/workspace/vede/zephyr/zephyr-fork/zephyr/soc/intel/nova_lake/Kconfig.sysbuild"
osource "/local/mnt/workspace/vede/zephyr/zephyr-fork/zephyr/soc/intel/lakemont/Kconfig.sysbuild"
osource "/local/mnt/workspace/vede/zephyr/zephyr-fork/zephyr/soc/intel/intel_socfpga_std/Kconfig.sysbuild"
osource "/local/mnt/workspace/vede/zephyr/zephyr-fork/zephyr/soc/intel/intel_socfpga/Kconfig.sysbuild"
osource "/local/mnt/workspace/vede/zephyr/zephyr-fork/zephyr/soc/intel/intel_niosv/Kconfig.sysbuild"
osource "/local/mnt/workspace/vede/zephyr/zephyr-fork/zephyr/soc/intel/intel_ish/Kconfig.sysbuild"
osource "/local/mnt/workspace/vede/zephyr/zephyr-fork/zephyr/soc/intel/intel_adsp/Kconfig.sysbuild"
osource "/local/mnt/workspace/vede/zephyr/zephyr-fork/zephyr/soc/intel/elkhart_lake/Kconfig.sysbuild"
osource "/local/mnt/workspace/vede/zephyr/zephyr-fork/zephyr/soc/intel/atom/Kconfig.sysbuild"
osource "/local/mnt/workspace/vede/zephyr/zephyr-fork/zephyr/soc/intel/apollo_lake/Kconfig.sysbuild"
osource "/local/mnt/workspace/vede/zephyr/zephyr-fork/zephyr/soc/intel/alder_lake/Kconfig.sysbuild"
osource "/local/mnt/workspace/vede/zephyr/zephyr-fork/zephyr/soc/infineon/psoc4/Kconfig.sysbuild"
osource "/local/mnt/workspace/vede/zephyr/zephyr-fork/zephyr/soc/infineon/edge/Kconfig.sysbuild"
osource "/local/mnt/workspace/vede/zephyr/zephyr-fork/zephyr/soc/infineon/cat3/Kconfig.sysbuild"
osource "/local/mnt/workspace/vede/zephyr/zephyr-fork/zephyr/soc/infineon/cat1c/Kconfig.sysbuild"
osource "/local/mnt/workspace/vede/zephyr/zephyr-fork/zephyr/soc/infineon/cat1b/Kconfig.sysbuild"
osource "/local/mnt/workspace/vede/zephyr/zephyr-fork/zephyr/soc/infineon/cat1a/Kconfig.sysbuild"
osource "/local/mnt/workspace/vede/zephyr/zephyr-fork/zephyr/soc/gd/gd32/Kconfig.sysbuild"
osource "/local/mnt/workspace/vede/zephyr/zephyr-fork/zephyr/soc/gaisler/leon3/Kconfig.sysbuild"
osource "/local/mnt/workspace/vede/zephyr/zephyr-fork/zephyr/soc/gaisler/gr716a/Kconfig.sysbuild"
osource "/local/mnt/workspace/vede/zephyr/zephyr-fork/zephyr/soc/focaltech/Kconfig.sysbuild"
osource "/local/mnt/workspace/vede/zephyr/zephyr-fork/zephyr/soc/espressif/Kconfig.sysbuild"
osource "/local/mnt/workspace/vede/zephyr/zephyr-fork/zephyr/soc/ene/kb1200/Kconfig.sysbuild"
osource "/local/mnt/workspace/vede/zephyr/zephyr-fork/zephyr/soc/ene/kb106x/Kconfig.sysbuild"
osource "/local/mnt/workspace/vede/zephyr/zephyr-fork/zephyr/soc/elan/em32f967/Kconfig.sysbuild"
osource "/local/mnt/workspace/vede/zephyr/zephyr-fork/zephyr/soc/egis/Kconfig.sysbuild"
osource "/local/mnt/workspace/vede/zephyr/zephyr-fork/zephyr/soc/efinix/sapphire/Kconfig.sysbuild"
osource "/local/mnt/workspace/vede/zephyr/zephyr-fork/zephyr/soc/cdns/xtensa_sample_controller/Kconfig.sysbuild"
osource "/local/mnt/workspace/vede/zephyr/zephyr-fork/zephyr/soc/cdns/swerv/Kconfig.sysbuild"
osource "/local/mnt/workspace/vede/zephyr/zephyr-fork/zephyr/soc/cdns/sample_controller32/Kconfig.sysbuild"
osource "/local/mnt/workspace/vede/zephyr/zephyr-fork/zephyr/soc/cdns/dc233c/Kconfig.sysbuild"
osource "/local/mnt/workspace/vede/zephyr/zephyr-fork/zephyr/soc/brcm/bcmvk/Kconfig.sysbuild"
osource "/local/mnt/workspace/vede/zephyr/zephyr-fork/zephyr/soc/brcm/bcm2712/Kconfig.sysbuild"
osource "/local/mnt/workspace/vede/zephyr/zephyr-fork/zephyr/soc/brcm/bcm2711/Kconfig.sysbuild"
osource "/local/mnt/workspace/vede/zephyr/zephyr-fork/zephyr/soc/brcm/bcm2710/Kconfig.sysbuild"
osource "/local/mnt/workspace/vede/zephyr/zephyr-fork/zephyr/soc/blackberry/qnxhv_vm/Kconfig.sysbuild"
osource "/local/mnt/workspace/vede/zephyr/zephyr-fork/zephyr/soc/bflb/Kconfig.sysbuild"
osource "/local/mnt/workspace/vede/zephyr/zephyr-fork/zephyr/soc/atmel/sam0/Kconfig.sysbuild"
osource "/local/mnt/workspace/vede/zephyr/zephyr-fork/zephyr/soc/atmel/sam/Kconfig.sysbuild"
osource "/local/mnt/workspace/vede/zephyr/zephyr-fork/zephyr/soc/aspeed/Kconfig.sysbuild"
osource "/local/mnt/workspace/vede/zephyr/zephyr-fork/zephyr/soc/arm/Kconfig.sysbuild"
osource "/local/mnt/workspace/vede/zephyr/zephyr-fork/zephyr/soc/antmicro/myra/Kconfig.sysbuild"
osource "/local/mnt/workspace/vede/zephyr/zephyr-fork/zephyr/soc/andestech/Kconfig.sysbuild"
osource "/local/mnt/workspace/vede/zephyr/zephyr-fork/zephyr/soc/amd/acp_7_x/Kconfig.sysbuild"
osource "/local/mnt/workspace/vede/zephyr/zephyr-fork/zephyr/soc/amd/acp_7_0/Kconfig.sysbuild"
osource "/local/mnt/workspace/vede/zephyr/zephyr-fork/zephyr/soc/amd/acp_6_0/Kconfig.sysbuild"
osource "/local/mnt/workspace/vede/zephyr/zephyr-fork/zephyr/soc/ambiq/Kconfig.sysbuild"
osource "/local/mnt/workspace/vede/zephyr/zephyr-fork/zephyr/soc/allwinner/sun8i_h3/Kconfig.sysbuild"
osource "/local/mnt/workspace/vede/zephyr/zephyr-fork/zephyr/soc/allwinner/sun50i_h618/Kconfig.sysbuild"
osource "/local/mnt/workspace/vede/zephyr/zephyr-fork/zephyr/soc/alif/ensemble/Kconfig.sysbuild"
osource "/local/mnt/workspace/vede/zephyr/zephyr-fork/zephyr/soc/alif/balletto/Kconfig.sysbuild"
osource "/local/mnt/workspace/vede/zephyr/zephyr-fork/zephyr/soc/aesc/Kconfig.sysbuild"
osource "/local/mnt/workspace/vede/zephyr/zephyr-fork/zephyr/soc/adi/max32/Kconfig.sysbuild"
```
