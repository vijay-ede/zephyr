## twister_qemu_riscv32_no_multithreading_llvm_cov_cpullvm_22_eld/qemu_riscv32_qemu_virt_riscv32/host_llvm/tests/kernel/threads/no-multithreading/kernel.threads.no-multithreading/Kconfig/soc/Kconfig.soc
```kconfig
# Load SoC Kconfig descriptions.
osource "/local/mnt/workspace/vede/zephyr/zephyr-fork/zephyr/soc/xlnx/zynqmp/Kconfig.soc"
osource "/local/mnt/workspace/vede/zephyr/zephyr-fork/zephyr/soc/xlnx/zynq7000/Kconfig.soc"
osource "/local/mnt/workspace/vede/zephyr/zephyr-fork/zephyr/soc/xlnx/versalnet/Kconfig.soc"
osource "/local/mnt/workspace/vede/zephyr/zephyr-fork/zephyr/soc/xlnx/versal2/Kconfig.soc"
osource "/local/mnt/workspace/vede/zephyr/zephyr-fork/zephyr/soc/xlnx/versal/Kconfig.soc"
osource "/local/mnt/workspace/vede/zephyr/zephyr-fork/zephyr/soc/xen/Kconfig.soc"
osource "/local/mnt/workspace/vede/zephyr/zephyr-fork/zephyr/soc/wch/ch32v/Kconfig.soc"
osource "/local/mnt/workspace/vede/zephyr/zephyr-fork/zephyr/soc/ti/tiva_c/Kconfig.soc"
osource "/local/mnt/workspace/vede/zephyr/zephyr-fork/zephyr/soc/ti/simplelink/Kconfig.soc"
osource "/local/mnt/workspace/vede/zephyr/zephyr-fork/zephyr/soc/ti/mspm/Kconfig.soc"
osource "/local/mnt/workspace/vede/zephyr/zephyr-fork/zephyr/soc/ti/lm3s6965/Kconfig.soc"
osource "/local/mnt/workspace/vede/zephyr/zephyr-fork/zephyr/soc/ti/k3/Kconfig.soc"
osource "/local/mnt/workspace/vede/zephyr/zephyr-fork/zephyr/soc/ti/am13/Kconfig.soc"
osource "/local/mnt/workspace/vede/zephyr/zephyr-fork/zephyr/soc/telink/tlsr/Kconfig.soc"
osource "/local/mnt/workspace/vede/zephyr/zephyr-fork/zephyr/soc/syna/sr100/Kconfig.soc"
osource "/local/mnt/workspace/vede/zephyr/zephyr-fork/zephyr/soc/starfive/jh71xx/Kconfig.soc"
osource "/local/mnt/workspace/vede/zephyr/zephyr-fork/zephyr/soc/st/stm32/Kconfig.soc"
osource "/local/mnt/workspace/vede/zephyr/zephyr-fork/zephyr/soc/snps/qemu_arc/Kconfig.soc"
osource "/local/mnt/workspace/vede/zephyr/zephyr-fork/zephyr/soc/snps/nsim/arc_v/Kconfig.soc"
osource "/local/mnt/workspace/vede/zephyr/zephyr-fork/zephyr/soc/snps/nsim/arc_classic/Kconfig.soc"
osource "/local/mnt/workspace/vede/zephyr/zephyr-fork/zephyr/soc/snps/hsdk4xd/Kconfig.soc"
osource "/local/mnt/workspace/vede/zephyr/zephyr-fork/zephyr/soc/snps/hsdk/Kconfig.soc"
osource "/local/mnt/workspace/vede/zephyr/zephyr-fork/zephyr/soc/snps/emsk/Kconfig.soc"
osource "/local/mnt/workspace/vede/zephyr/zephyr-fork/zephyr/soc/snps/emsdp/Kconfig.soc"
osource "/local/mnt/workspace/vede/zephyr/zephyr-fork/zephyr/soc/snps/arc_iot/Kconfig.soc"
osource "/local/mnt/workspace/vede/zephyr/zephyr-fork/zephyr/soc/silabs/Kconfig.soc"
osource "/local/mnt/workspace/vede/zephyr/zephyr-fork/zephyr/soc/sifli/sf32/Kconfig.soc"
osource "/local/mnt/workspace/vede/zephyr/zephyr-fork/zephyr/soc/sifive/sifive_freedom/Kconfig.soc"
osource "/local/mnt/workspace/vede/zephyr/zephyr-fork/zephyr/soc/shakti/Kconfig.soc"
osource "/local/mnt/workspace/vede/zephyr/zephyr-fork/zephyr/soc/sensry/Kconfig.soc"
osource "/local/mnt/workspace/vede/zephyr/zephyr-fork/zephyr/soc/rockchip/Kconfig.soc"
osource "/local/mnt/workspace/vede/zephyr/zephyr-fork/zephyr/soc/renode/riscv_virtual/Kconfig.soc"
osource "/local/mnt/workspace/vede/zephyr/zephyr-fork/zephyr/soc/renode/cortex_r8_virtual/Kconfig.soc"
osource "/local/mnt/workspace/vede/zephyr/zephyr-fork/zephyr/soc/renesas/smartbond/Kconfig.soc"
osource "/local/mnt/workspace/vede/zephyr/zephyr-fork/zephyr/soc/renesas/rz/Kconfig.soc"
osource "/local/mnt/workspace/vede/zephyr/zephyr-fork/zephyr/soc/renesas/rx/Kconfig.soc"
osource "/local/mnt/workspace/vede/zephyr/zephyr-fork/zephyr/soc/renesas/rcar/Kconfig.soc"
osource "/local/mnt/workspace/vede/zephyr/zephyr-fork/zephyr/soc/renesas/ra/Kconfig.soc"
osource "/local/mnt/workspace/vede/zephyr/zephyr-fork/zephyr/soc/realtek/fingerprint/Kconfig.soc"
osource "/local/mnt/workspace/vede/zephyr/zephyr-fork/zephyr/soc/realtek/ec/Kconfig.soc"
osource "/local/mnt/workspace/vede/zephyr/zephyr-fork/zephyr/soc/realtek/bee/Kconfig.soc"
osource "/local/mnt/workspace/vede/zephyr/zephyr-fork/zephyr/soc/realtek/ameba/Kconfig.soc"
osource "/local/mnt/workspace/vede/zephyr/zephyr-fork/zephyr/soc/raspberrypi/rpi_pico/Kconfig.soc"
osource "/local/mnt/workspace/vede/zephyr/zephyr-fork/zephyr/soc/quicklogic/eos_s3/Kconfig.soc"
osource "/local/mnt/workspace/vede/zephyr/zephyr-fork/zephyr/soc/qemu/virt_riscv/Kconfig.soc"
osource "/local/mnt/workspace/vede/zephyr/zephyr-fork/zephyr/soc/qemu/or1k/Kconfig.soc"
osource "/local/mnt/workspace/vede/zephyr/zephyr-fork/zephyr/soc/qemu/malta/Kconfig.soc"
osource "/local/mnt/workspace/vede/zephyr/zephyr-fork/zephyr/soc/openisa/rv32m1/Kconfig.soc"
osource "/local/mnt/workspace/vede/zephyr/zephyr-fork/zephyr/soc/openhwgroup/cva6/Kconfig.soc"
osource "/local/mnt/workspace/vede/zephyr/zephyr-fork/zephyr/soc/oct/osd32mp15x/Kconfig.soc"
osource "/local/mnt/workspace/vede/zephyr/zephyr-fork/zephyr/soc/nxp/s32/Kconfig.soc"
osource "/local/mnt/workspace/vede/zephyr/zephyr-fork/zephyr/soc/nxp/rw/Kconfig.soc"
osource "/local/mnt/workspace/vede/zephyr/zephyr-fork/zephyr/soc/nxp/mcx/Kconfig.soc"
osource "/local/mnt/workspace/vede/zephyr/zephyr-fork/zephyr/soc/nxp/lpc/Kconfig.soc"
osource "/local/mnt/workspace/vede/zephyr/zephyr-fork/zephyr/soc/nxp/layerscape/Kconfig.soc"
osource "/local/mnt/workspace/vede/zephyr/zephyr-fork/zephyr/soc/nxp/kinetis/Kconfig.soc"
osource "/local/mnt/workspace/vede/zephyr/zephyr-fork/zephyr/soc/nxp/imxrt/Kconfig.soc"
osource "/local/mnt/workspace/vede/zephyr/zephyr-fork/zephyr/soc/nxp/imx/Kconfig.soc"
osource "/local/mnt/workspace/vede/zephyr/zephyr-fork/zephyr/soc/nuvoton/numicro/Kconfig.soc"
osource "/local/mnt/workspace/vede/zephyr/zephyr-fork/zephyr/soc/nuvoton/numaker/Kconfig.soc"
osource "/local/mnt/workspace/vede/zephyr/zephyr-fork/zephyr/soc/nuvoton/npcx/Kconfig.soc"
osource "/local/mnt/workspace/vede/zephyr/zephyr-fork/zephyr/soc/nuvoton/npcm/Kconfig.soc"
osource "/local/mnt/workspace/vede/zephyr/zephyr-fork/zephyr/soc/nordic/Kconfig.soc"
osource "/local/mnt/workspace/vede/zephyr/zephyr-fork/zephyr/soc/neorv32/Kconfig.soc"
osource "/local/mnt/workspace/vede/zephyr/zephyr-fork/zephyr/soc/native/inf_clock/Kconfig.soc"
osource "/local/mnt/workspace/vede/zephyr/zephyr-fork/zephyr/soc/microchip/smartfusion2/Kconfig.soc"
osource "/local/mnt/workspace/vede/zephyr/zephyr-fork/zephyr/soc/microchip/sam/sama7/Kconfig.soc"
osource "/local/mnt/workspace/vede/zephyr/zephyr-fork/zephyr/soc/microchip/sam/sama5/Kconfig.soc"
osource "/local/mnt/workspace/vede/zephyr/zephyr-fork/zephyr/soc/microchip/sam/sam_d5x_e5x/Kconfig.soc"
osource "/local/mnt/workspace/vede/zephyr/zephyr-fork/zephyr/soc/microchip/pic64/Kconfig.soc"
osource "/local/mnt/workspace/vede/zephyr/zephyr-fork/zephyr/soc/microchip/pic32c/pic32cz_ca/Kconfig.soc"
osource "/local/mnt/workspace/vede/zephyr/zephyr-fork/zephyr/soc/microchip/pic32c/pic32cx_sg/Kconfig.soc"
osource "/local/mnt/workspace/vede/zephyr/zephyr-fork/zephyr/soc/microchip/pic32c/pic32cm_sg_gc/Kconfig.soc"
osource "/local/mnt/workspace/vede/zephyr/zephyr-fork/zephyr/soc/microchip/pic32c/pic32cm_pl/Kconfig.soc"
osource "/local/mnt/workspace/vede/zephyr/zephyr-fork/zephyr/soc/microchip/pic32c/pic32cm_jh/Kconfig.soc"
osource "/local/mnt/workspace/vede/zephyr/zephyr-fork/zephyr/soc/microchip/pic32c/pic32ck_sg_gc/Kconfig.soc"
osource "/local/mnt/workspace/vede/zephyr/zephyr-fork/zephyr/soc/microchip/miv/Kconfig.soc"
osource "/local/mnt/workspace/vede/zephyr/zephyr-fork/zephyr/soc/microchip/mec/Kconfig.soc"
osource "/local/mnt/workspace/vede/zephyr/zephyr-fork/zephyr/soc/mediatek/mt8xxx/Kconfig.soc"
osource "/local/mnt/workspace/vede/zephyr/zephyr-fork/zephyr/soc/lowrisc/opentitan/Kconfig.soc"
osource "/local/mnt/workspace/vede/zephyr/zephyr-fork/zephyr/soc/litex/Kconfig.soc"
osource "/local/mnt/workspace/vede/zephyr/zephyr-fork/zephyr/soc/ite/ec/Kconfig.soc"
osource "/local/mnt/workspace/vede/zephyr/zephyr-fork/zephyr/soc/intel/wildcat_lake/Kconfig.soc"
osource "/local/mnt/workspace/vede/zephyr/zephyr-fork/zephyr/soc/intel/raptor_lake/Kconfig.soc"
osource "/local/mnt/workspace/vede/zephyr/zephyr-fork/zephyr/soc/intel/panther_lake/Kconfig.soc"
osource "/local/mnt/workspace/vede/zephyr/zephyr-fork/zephyr/soc/intel/nova_lake/Kconfig.soc"
osource "/local/mnt/workspace/vede/zephyr/zephyr-fork/zephyr/soc/intel/lakemont/Kconfig.soc"
osource "/local/mnt/workspace/vede/zephyr/zephyr-fork/zephyr/soc/intel/intel_socfpga_std/Kconfig.soc"
osource "/local/mnt/workspace/vede/zephyr/zephyr-fork/zephyr/soc/intel/intel_socfpga/Kconfig.soc"
osource "/local/mnt/workspace/vede/zephyr/zephyr-fork/zephyr/soc/intel/intel_niosv/Kconfig.soc"
osource "/local/mnt/workspace/vede/zephyr/zephyr-fork/zephyr/soc/intel/intel_ish/Kconfig.soc"
osource "/local/mnt/workspace/vede/zephyr/zephyr-fork/zephyr/soc/intel/intel_adsp/Kconfig.soc"
osource "/local/mnt/workspace/vede/zephyr/zephyr-fork/zephyr/soc/intel/elkhart_lake/Kconfig.soc"
osource "/local/mnt/workspace/vede/zephyr/zephyr-fork/zephyr/soc/intel/atom/Kconfig.soc"
osource "/local/mnt/workspace/vede/zephyr/zephyr-fork/zephyr/soc/intel/apollo_lake/Kconfig.soc"
osource "/local/mnt/workspace/vede/zephyr/zephyr-fork/zephyr/soc/intel/alder_lake/Kconfig.soc"
osource "/local/mnt/workspace/vede/zephyr/zephyr-fork/zephyr/soc/infineon/psoc4/Kconfig.soc"
osource "/local/mnt/workspace/vede/zephyr/zephyr-fork/zephyr/soc/infineon/edge/Kconfig.soc"
osource "/local/mnt/workspace/vede/zephyr/zephyr-fork/zephyr/soc/infineon/cat3/Kconfig.soc"
osource "/local/mnt/workspace/vede/zephyr/zephyr-fork/zephyr/soc/infineon/cat1c/Kconfig.soc"
osource "/local/mnt/workspace/vede/zephyr/zephyr-fork/zephyr/soc/infineon/cat1b/Kconfig.soc"
osource "/local/mnt/workspace/vede/zephyr/zephyr-fork/zephyr/soc/infineon/cat1a/Kconfig.soc"
osource "/local/mnt/workspace/vede/zephyr/zephyr-fork/zephyr/soc/gd/gd32/Kconfig.soc"
osource "/local/mnt/workspace/vede/zephyr/zephyr-fork/zephyr/soc/gaisler/leon3/Kconfig.soc"
osource "/local/mnt/workspace/vede/zephyr/zephyr-fork/zephyr/soc/gaisler/gr716a/Kconfig.soc"
osource "/local/mnt/workspace/vede/zephyr/zephyr-fork/zephyr/soc/focaltech/Kconfig.soc"
osource "/local/mnt/workspace/vede/zephyr/zephyr-fork/zephyr/soc/espressif/Kconfig.soc"
osource "/local/mnt/workspace/vede/zephyr/zephyr-fork/zephyr/soc/ene/kb1200/Kconfig.soc"
osource "/local/mnt/workspace/vede/zephyr/zephyr-fork/zephyr/soc/ene/kb106x/Kconfig.soc"
osource "/local/mnt/workspace/vede/zephyr/zephyr-fork/zephyr/soc/elan/em32f967/Kconfig.soc"
osource "/local/mnt/workspace/vede/zephyr/zephyr-fork/zephyr/soc/egis/Kconfig.soc"
osource "/local/mnt/workspace/vede/zephyr/zephyr-fork/zephyr/soc/efinix/sapphire/Kconfig.soc"
osource "/local/mnt/workspace/vede/zephyr/zephyr-fork/zephyr/soc/cdns/xtensa_sample_controller/Kconfig.soc"
osource "/local/mnt/workspace/vede/zephyr/zephyr-fork/zephyr/soc/cdns/swerv/Kconfig.soc"
osource "/local/mnt/workspace/vede/zephyr/zephyr-fork/zephyr/soc/cdns/sample_controller32/Kconfig.soc"
osource "/local/mnt/workspace/vede/zephyr/zephyr-fork/zephyr/soc/cdns/dc233c/Kconfig.soc"
osource "/local/mnt/workspace/vede/zephyr/zephyr-fork/zephyr/soc/brcm/bcmvk/Kconfig.soc"
osource "/local/mnt/workspace/vede/zephyr/zephyr-fork/zephyr/soc/brcm/bcm2712/Kconfig.soc"
osource "/local/mnt/workspace/vede/zephyr/zephyr-fork/zephyr/soc/brcm/bcm2711/Kconfig.soc"
osource "/local/mnt/workspace/vede/zephyr/zephyr-fork/zephyr/soc/brcm/bcm2710/Kconfig.soc"
osource "/local/mnt/workspace/vede/zephyr/zephyr-fork/zephyr/soc/blackberry/qnxhv_vm/Kconfig.soc"
osource "/local/mnt/workspace/vede/zephyr/zephyr-fork/zephyr/soc/bflb/Kconfig.soc"
osource "/local/mnt/workspace/vede/zephyr/zephyr-fork/zephyr/soc/atmel/sam0/Kconfig.soc"
osource "/local/mnt/workspace/vede/zephyr/zephyr-fork/zephyr/soc/atmel/sam/Kconfig.soc"
osource "/local/mnt/workspace/vede/zephyr/zephyr-fork/zephyr/soc/aspeed/Kconfig.soc"
osource "/local/mnt/workspace/vede/zephyr/zephyr-fork/zephyr/soc/arm/Kconfig.soc"
osource "/local/mnt/workspace/vede/zephyr/zephyr-fork/zephyr/soc/antmicro/myra/Kconfig.soc"
osource "/local/mnt/workspace/vede/zephyr/zephyr-fork/zephyr/soc/andestech/Kconfig.soc"
osource "/local/mnt/workspace/vede/zephyr/zephyr-fork/zephyr/soc/amd/acp_7_x/Kconfig.soc"
osource "/local/mnt/workspace/vede/zephyr/zephyr-fork/zephyr/soc/amd/acp_7_0/Kconfig.soc"
osource "/local/mnt/workspace/vede/zephyr/zephyr-fork/zephyr/soc/amd/acp_6_0/Kconfig.soc"
osource "/local/mnt/workspace/vede/zephyr/zephyr-fork/zephyr/soc/ambiq/Kconfig.soc"
osource "/local/mnt/workspace/vede/zephyr/zephyr-fork/zephyr/soc/allwinner/sun8i_h3/Kconfig.soc"
osource "/local/mnt/workspace/vede/zephyr/zephyr-fork/zephyr/soc/allwinner/sun50i_h618/Kconfig.soc"
osource "/local/mnt/workspace/vede/zephyr/zephyr-fork/zephyr/soc/alif/ensemble/Kconfig.soc"
osource "/local/mnt/workspace/vede/zephyr/zephyr-fork/zephyr/soc/alif/balletto/Kconfig.soc"
osource "/local/mnt/workspace/vede/zephyr/zephyr-fork/zephyr/soc/aesc/Kconfig.soc"
osource "/local/mnt/workspace/vede/zephyr/zephyr-fork/zephyr/soc/adi/max32/Kconfig.soc"
```
