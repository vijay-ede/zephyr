## twister_qemu_riscv32_no_multithreading_llvm_cov_cpullvm_22_eld/qemu_riscv32_qemu_virt_riscv32/host_llvm/tests/kernel/threads/no-multithreading/kernel.threads.no-multithreading/Kconfig/soc/Kconfig.defconfig
```kconfig
# Load Zephyr SoC defconfig descriptions.
osource "/local/mnt/workspace/vede/zephyr/zephyr-fork/zephyr/soc/xlnx/zynqmp/Kconfig.defconfig"
osource "/local/mnt/workspace/vede/zephyr/zephyr-fork/zephyr/soc/xlnx/zynq7000/Kconfig.defconfig"
osource "/local/mnt/workspace/vede/zephyr/zephyr-fork/zephyr/soc/xlnx/versalnet/Kconfig.defconfig"
osource "/local/mnt/workspace/vede/zephyr/zephyr-fork/zephyr/soc/xlnx/versal2/Kconfig.defconfig"
osource "/local/mnt/workspace/vede/zephyr/zephyr-fork/zephyr/soc/xlnx/versal/Kconfig.defconfig"
osource "/local/mnt/workspace/vede/zephyr/zephyr-fork/zephyr/soc/xen/Kconfig.defconfig"
osource "/local/mnt/workspace/vede/zephyr/zephyr-fork/zephyr/soc/wch/ch32v/Kconfig.defconfig"
osource "/local/mnt/workspace/vede/zephyr/zephyr-fork/zephyr/soc/ti/tiva_c/Kconfig.defconfig"
osource "/local/mnt/workspace/vede/zephyr/zephyr-fork/zephyr/soc/ti/simplelink/Kconfig.defconfig"
osource "/local/mnt/workspace/vede/zephyr/zephyr-fork/zephyr/soc/ti/mspm/Kconfig.defconfig"
osource "/local/mnt/workspace/vede/zephyr/zephyr-fork/zephyr/soc/ti/lm3s6965/Kconfig.defconfig"
osource "/local/mnt/workspace/vede/zephyr/zephyr-fork/zephyr/soc/ti/k3/Kconfig.defconfig"
osource "/local/mnt/workspace/vede/zephyr/zephyr-fork/zephyr/soc/ti/am13/Kconfig.defconfig"
osource "/local/mnt/workspace/vede/zephyr/zephyr-fork/zephyr/soc/telink/tlsr/Kconfig.defconfig"
osource "/local/mnt/workspace/vede/zephyr/zephyr-fork/zephyr/soc/syna/sr100/Kconfig.defconfig"
osource "/local/mnt/workspace/vede/zephyr/zephyr-fork/zephyr/soc/starfive/jh71xx/Kconfig.defconfig"
osource "/local/mnt/workspace/vede/zephyr/zephyr-fork/zephyr/soc/st/stm32/Kconfig.defconfig"
osource "/local/mnt/workspace/vede/zephyr/zephyr-fork/zephyr/soc/snps/qemu_arc/Kconfig.defconfig"
osource "/local/mnt/workspace/vede/zephyr/zephyr-fork/zephyr/soc/snps/nsim/arc_v/Kconfig.defconfig"
osource "/local/mnt/workspace/vede/zephyr/zephyr-fork/zephyr/soc/snps/nsim/arc_classic/Kconfig.defconfig"
osource "/local/mnt/workspace/vede/zephyr/zephyr-fork/zephyr/soc/snps/hsdk4xd/Kconfig.defconfig"
osource "/local/mnt/workspace/vede/zephyr/zephyr-fork/zephyr/soc/snps/hsdk/Kconfig.defconfig"
osource "/local/mnt/workspace/vede/zephyr/zephyr-fork/zephyr/soc/snps/emsk/Kconfig.defconfig"
osource "/local/mnt/workspace/vede/zephyr/zephyr-fork/zephyr/soc/snps/emsdp/Kconfig.defconfig"
osource "/local/mnt/workspace/vede/zephyr/zephyr-fork/zephyr/soc/snps/arc_iot/Kconfig.defconfig"
osource "/local/mnt/workspace/vede/zephyr/zephyr-fork/zephyr/soc/silabs/Kconfig.defconfig"
osource "/local/mnt/workspace/vede/zephyr/zephyr-fork/zephyr/soc/sifli/sf32/Kconfig.defconfig"
osource "/local/mnt/workspace/vede/zephyr/zephyr-fork/zephyr/soc/sifive/sifive_freedom/Kconfig.defconfig"
osource "/local/mnt/workspace/vede/zephyr/zephyr-fork/zephyr/soc/shakti/Kconfig.defconfig"
osource "/local/mnt/workspace/vede/zephyr/zephyr-fork/zephyr/soc/sensry/Kconfig.defconfig"
osource "/local/mnt/workspace/vede/zephyr/zephyr-fork/zephyr/soc/rockchip/Kconfig.defconfig"
osource "/local/mnt/workspace/vede/zephyr/zephyr-fork/zephyr/soc/renode/riscv_virtual/Kconfig.defconfig"
osource "/local/mnt/workspace/vede/zephyr/zephyr-fork/zephyr/soc/renode/cortex_r8_virtual/Kconfig.defconfig"
osource "/local/mnt/workspace/vede/zephyr/zephyr-fork/zephyr/soc/renesas/smartbond/Kconfig.defconfig"
osource "/local/mnt/workspace/vede/zephyr/zephyr-fork/zephyr/soc/renesas/rz/Kconfig.defconfig"
osource "/local/mnt/workspace/vede/zephyr/zephyr-fork/zephyr/soc/renesas/rx/Kconfig.defconfig"
osource "/local/mnt/workspace/vede/zephyr/zephyr-fork/zephyr/soc/renesas/rcar/Kconfig.defconfig"
osource "/local/mnt/workspace/vede/zephyr/zephyr-fork/zephyr/soc/renesas/ra/Kconfig.defconfig"
osource "/local/mnt/workspace/vede/zephyr/zephyr-fork/zephyr/soc/realtek/fingerprint/Kconfig.defconfig"
osource "/local/mnt/workspace/vede/zephyr/zephyr-fork/zephyr/soc/realtek/ec/Kconfig.defconfig"
osource "/local/mnt/workspace/vede/zephyr/zephyr-fork/zephyr/soc/realtek/bee/Kconfig.defconfig"
osource "/local/mnt/workspace/vede/zephyr/zephyr-fork/zephyr/soc/realtek/ameba/Kconfig.defconfig"
osource "/local/mnt/workspace/vede/zephyr/zephyr-fork/zephyr/soc/raspberrypi/rpi_pico/Kconfig.defconfig"
osource "/local/mnt/workspace/vede/zephyr/zephyr-fork/zephyr/soc/quicklogic/eos_s3/Kconfig.defconfig"
osource "/local/mnt/workspace/vede/zephyr/zephyr-fork/zephyr/soc/qemu/virt_riscv/Kconfig.defconfig"
osource "/local/mnt/workspace/vede/zephyr/zephyr-fork/zephyr/soc/qemu/or1k/Kconfig.defconfig"
osource "/local/mnt/workspace/vede/zephyr/zephyr-fork/zephyr/soc/qemu/malta/Kconfig.defconfig"
osource "/local/mnt/workspace/vede/zephyr/zephyr-fork/zephyr/soc/openisa/rv32m1/Kconfig.defconfig"
osource "/local/mnt/workspace/vede/zephyr/zephyr-fork/zephyr/soc/openhwgroup/cva6/Kconfig.defconfig"
osource "/local/mnt/workspace/vede/zephyr/zephyr-fork/zephyr/soc/oct/osd32mp15x/Kconfig.defconfig"
osource "/local/mnt/workspace/vede/zephyr/zephyr-fork/zephyr/soc/nxp/s32/Kconfig.defconfig"
osource "/local/mnt/workspace/vede/zephyr/zephyr-fork/zephyr/soc/nxp/rw/Kconfig.defconfig"
osource "/local/mnt/workspace/vede/zephyr/zephyr-fork/zephyr/soc/nxp/mcx/Kconfig.defconfig"
osource "/local/mnt/workspace/vede/zephyr/zephyr-fork/zephyr/soc/nxp/lpc/Kconfig.defconfig"
osource "/local/mnt/workspace/vede/zephyr/zephyr-fork/zephyr/soc/nxp/layerscape/Kconfig.defconfig"
osource "/local/mnt/workspace/vede/zephyr/zephyr-fork/zephyr/soc/nxp/kinetis/Kconfig.defconfig"
osource "/local/mnt/workspace/vede/zephyr/zephyr-fork/zephyr/soc/nxp/imxrt/Kconfig.defconfig"
osource "/local/mnt/workspace/vede/zephyr/zephyr-fork/zephyr/soc/nxp/imx/Kconfig.defconfig"
osource "/local/mnt/workspace/vede/zephyr/zephyr-fork/zephyr/soc/nuvoton/numicro/Kconfig.defconfig"
osource "/local/mnt/workspace/vede/zephyr/zephyr-fork/zephyr/soc/nuvoton/numaker/Kconfig.defconfig"
osource "/local/mnt/workspace/vede/zephyr/zephyr-fork/zephyr/soc/nuvoton/npcx/Kconfig.defconfig"
osource "/local/mnt/workspace/vede/zephyr/zephyr-fork/zephyr/soc/nuvoton/npcm/Kconfig.defconfig"
osource "/local/mnt/workspace/vede/zephyr/zephyr-fork/zephyr/soc/nordic/Kconfig.defconfig"
osource "/local/mnt/workspace/vede/zephyr/zephyr-fork/zephyr/soc/neorv32/Kconfig.defconfig"
osource "/local/mnt/workspace/vede/zephyr/zephyr-fork/zephyr/soc/native/inf_clock/Kconfig.defconfig"
osource "/local/mnt/workspace/vede/zephyr/zephyr-fork/zephyr/soc/microchip/smartfusion2/Kconfig.defconfig"
osource "/local/mnt/workspace/vede/zephyr/zephyr-fork/zephyr/soc/microchip/sam/sama7/Kconfig.defconfig"
osource "/local/mnt/workspace/vede/zephyr/zephyr-fork/zephyr/soc/microchip/sam/sama5/Kconfig.defconfig"
osource "/local/mnt/workspace/vede/zephyr/zephyr-fork/zephyr/soc/microchip/sam/sam_d5x_e5x/Kconfig.defconfig"
osource "/local/mnt/workspace/vede/zephyr/zephyr-fork/zephyr/soc/microchip/pic64/Kconfig.defconfig"
osource "/local/mnt/workspace/vede/zephyr/zephyr-fork/zephyr/soc/microchip/pic32c/pic32cz_ca/Kconfig.defconfig"
osource "/local/mnt/workspace/vede/zephyr/zephyr-fork/zephyr/soc/microchip/pic32c/pic32cx_sg/Kconfig.defconfig"
osource "/local/mnt/workspace/vede/zephyr/zephyr-fork/zephyr/soc/microchip/pic32c/pic32cm_sg_gc/Kconfig.defconfig"
osource "/local/mnt/workspace/vede/zephyr/zephyr-fork/zephyr/soc/microchip/pic32c/pic32cm_pl/Kconfig.defconfig"
osource "/local/mnt/workspace/vede/zephyr/zephyr-fork/zephyr/soc/microchip/pic32c/pic32cm_jh/Kconfig.defconfig"
osource "/local/mnt/workspace/vede/zephyr/zephyr-fork/zephyr/soc/microchip/pic32c/pic32ck_sg_gc/Kconfig.defconfig"
osource "/local/mnt/workspace/vede/zephyr/zephyr-fork/zephyr/soc/microchip/miv/Kconfig.defconfig"
osource "/local/mnt/workspace/vede/zephyr/zephyr-fork/zephyr/soc/microchip/mec/Kconfig.defconfig"
osource "/local/mnt/workspace/vede/zephyr/zephyr-fork/zephyr/soc/mediatek/mt8xxx/Kconfig.defconfig"
osource "/local/mnt/workspace/vede/zephyr/zephyr-fork/zephyr/soc/lowrisc/opentitan/Kconfig.defconfig"
osource "/local/mnt/workspace/vede/zephyr/zephyr-fork/zephyr/soc/litex/Kconfig.defconfig"
osource "/local/mnt/workspace/vede/zephyr/zephyr-fork/zephyr/soc/ite/ec/Kconfig.defconfig"
osource "/local/mnt/workspace/vede/zephyr/zephyr-fork/zephyr/soc/intel/wildcat_lake/Kconfig.defconfig"
osource "/local/mnt/workspace/vede/zephyr/zephyr-fork/zephyr/soc/intel/raptor_lake/Kconfig.defconfig"
osource "/local/mnt/workspace/vede/zephyr/zephyr-fork/zephyr/soc/intel/panther_lake/Kconfig.defconfig"
osource "/local/mnt/workspace/vede/zephyr/zephyr-fork/zephyr/soc/intel/nova_lake/Kconfig.defconfig"
osource "/local/mnt/workspace/vede/zephyr/zephyr-fork/zephyr/soc/intel/lakemont/Kconfig.defconfig"
osource "/local/mnt/workspace/vede/zephyr/zephyr-fork/zephyr/soc/intel/intel_socfpga_std/Kconfig.defconfig"
osource "/local/mnt/workspace/vede/zephyr/zephyr-fork/zephyr/soc/intel/intel_socfpga/Kconfig.defconfig"
osource "/local/mnt/workspace/vede/zephyr/zephyr-fork/zephyr/soc/intel/intel_niosv/Kconfig.defconfig"
osource "/local/mnt/workspace/vede/zephyr/zephyr-fork/zephyr/soc/intel/intel_ish/Kconfig.defconfig"
osource "/local/mnt/workspace/vede/zephyr/zephyr-fork/zephyr/soc/intel/intel_adsp/Kconfig.defconfig"
osource "/local/mnt/workspace/vede/zephyr/zephyr-fork/zephyr/soc/intel/elkhart_lake/Kconfig.defconfig"
osource "/local/mnt/workspace/vede/zephyr/zephyr-fork/zephyr/soc/intel/atom/Kconfig.defconfig"
osource "/local/mnt/workspace/vede/zephyr/zephyr-fork/zephyr/soc/intel/apollo_lake/Kconfig.defconfig"
osource "/local/mnt/workspace/vede/zephyr/zephyr-fork/zephyr/soc/intel/alder_lake/Kconfig.defconfig"
osource "/local/mnt/workspace/vede/zephyr/zephyr-fork/zephyr/soc/infineon/psoc4/Kconfig.defconfig"
osource "/local/mnt/workspace/vede/zephyr/zephyr-fork/zephyr/soc/infineon/edge/Kconfig.defconfig"
osource "/local/mnt/workspace/vede/zephyr/zephyr-fork/zephyr/soc/infineon/cat3/Kconfig.defconfig"
osource "/local/mnt/workspace/vede/zephyr/zephyr-fork/zephyr/soc/infineon/cat1c/Kconfig.defconfig"
osource "/local/mnt/workspace/vede/zephyr/zephyr-fork/zephyr/soc/infineon/cat1b/Kconfig.defconfig"
osource "/local/mnt/workspace/vede/zephyr/zephyr-fork/zephyr/soc/infineon/cat1a/Kconfig.defconfig"
osource "/local/mnt/workspace/vede/zephyr/zephyr-fork/zephyr/soc/gd/gd32/Kconfig.defconfig"
osource "/local/mnt/workspace/vede/zephyr/zephyr-fork/zephyr/soc/gaisler/leon3/Kconfig.defconfig"
osource "/local/mnt/workspace/vede/zephyr/zephyr-fork/zephyr/soc/gaisler/gr716a/Kconfig.defconfig"
osource "/local/mnt/workspace/vede/zephyr/zephyr-fork/zephyr/soc/focaltech/Kconfig.defconfig"
osource "/local/mnt/workspace/vede/zephyr/zephyr-fork/zephyr/soc/espressif/Kconfig.defconfig"
osource "/local/mnt/workspace/vede/zephyr/zephyr-fork/zephyr/soc/ene/kb1200/Kconfig.defconfig"
osource "/local/mnt/workspace/vede/zephyr/zephyr-fork/zephyr/soc/ene/kb106x/Kconfig.defconfig"
osource "/local/mnt/workspace/vede/zephyr/zephyr-fork/zephyr/soc/elan/em32f967/Kconfig.defconfig"
osource "/local/mnt/workspace/vede/zephyr/zephyr-fork/zephyr/soc/egis/Kconfig.defconfig"
osource "/local/mnt/workspace/vede/zephyr/zephyr-fork/zephyr/soc/efinix/sapphire/Kconfig.defconfig"
osource "/local/mnt/workspace/vede/zephyr/zephyr-fork/zephyr/soc/cdns/xtensa_sample_controller/Kconfig.defconfig"
osource "/local/mnt/workspace/vede/zephyr/zephyr-fork/zephyr/soc/cdns/swerv/Kconfig.defconfig"
osource "/local/mnt/workspace/vede/zephyr/zephyr-fork/zephyr/soc/cdns/sample_controller32/Kconfig.defconfig"
osource "/local/mnt/workspace/vede/zephyr/zephyr-fork/zephyr/soc/cdns/dc233c/Kconfig.defconfig"
osource "/local/mnt/workspace/vede/zephyr/zephyr-fork/zephyr/soc/brcm/bcmvk/Kconfig.defconfig"
osource "/local/mnt/workspace/vede/zephyr/zephyr-fork/zephyr/soc/brcm/bcm2712/Kconfig.defconfig"
osource "/local/mnt/workspace/vede/zephyr/zephyr-fork/zephyr/soc/brcm/bcm2711/Kconfig.defconfig"
osource "/local/mnt/workspace/vede/zephyr/zephyr-fork/zephyr/soc/brcm/bcm2710/Kconfig.defconfig"
osource "/local/mnt/workspace/vede/zephyr/zephyr-fork/zephyr/soc/blackberry/qnxhv_vm/Kconfig.defconfig"
osource "/local/mnt/workspace/vede/zephyr/zephyr-fork/zephyr/soc/bflb/Kconfig.defconfig"
osource "/local/mnt/workspace/vede/zephyr/zephyr-fork/zephyr/soc/atmel/sam0/Kconfig.defconfig"
osource "/local/mnt/workspace/vede/zephyr/zephyr-fork/zephyr/soc/atmel/sam/Kconfig.defconfig"
osource "/local/mnt/workspace/vede/zephyr/zephyr-fork/zephyr/soc/aspeed/Kconfig.defconfig"
osource "/local/mnt/workspace/vede/zephyr/zephyr-fork/zephyr/soc/arm/Kconfig.defconfig"
osource "/local/mnt/workspace/vede/zephyr/zephyr-fork/zephyr/soc/antmicro/myra/Kconfig.defconfig"
osource "/local/mnt/workspace/vede/zephyr/zephyr-fork/zephyr/soc/andestech/Kconfig.defconfig"
osource "/local/mnt/workspace/vede/zephyr/zephyr-fork/zephyr/soc/amd/acp_7_x/Kconfig.defconfig"
osource "/local/mnt/workspace/vede/zephyr/zephyr-fork/zephyr/soc/amd/acp_7_0/Kconfig.defconfig"
osource "/local/mnt/workspace/vede/zephyr/zephyr-fork/zephyr/soc/amd/acp_6_0/Kconfig.defconfig"
osource "/local/mnt/workspace/vede/zephyr/zephyr-fork/zephyr/soc/ambiq/Kconfig.defconfig"
osource "/local/mnt/workspace/vede/zephyr/zephyr-fork/zephyr/soc/allwinner/sun8i_h3/Kconfig.defconfig"
osource "/local/mnt/workspace/vede/zephyr/zephyr-fork/zephyr/soc/allwinner/sun50i_h618/Kconfig.defconfig"
osource "/local/mnt/workspace/vede/zephyr/zephyr-fork/zephyr/soc/alif/ensemble/Kconfig.defconfig"
osource "/local/mnt/workspace/vede/zephyr/zephyr-fork/zephyr/soc/alif/balletto/Kconfig.defconfig"
osource "/local/mnt/workspace/vede/zephyr/zephyr-fork/zephyr/soc/aesc/Kconfig.defconfig"
osource "/local/mnt/workspace/vede/zephyr/zephyr-fork/zephyr/soc/adi/max32/Kconfig.defconfig"
```
