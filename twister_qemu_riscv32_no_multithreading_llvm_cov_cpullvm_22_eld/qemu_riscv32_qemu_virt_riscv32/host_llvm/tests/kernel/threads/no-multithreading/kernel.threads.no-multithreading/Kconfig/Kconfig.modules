## twister_qemu_riscv32_no_multithreading_llvm_cov_cpullvm_22_eld/qemu_riscv32_qemu_virt_riscv32/host_llvm/tests/kernel/threads/no-multithreading/kernel.threads.no-multithreading/Kconfig/soc/Kconfig
```kconfig
# Load Zephyr SoC Kconfig descriptions.
osource "/local/mnt/workspace/vede/zephyr/zephyr-fork/zephyr/soc/xlnx/zynqmp/Kconfig"
osource "/local/mnt/workspace/vede/zephyr/zephyr-fork/zephyr/soc/xlnx/zynq7000/Kconfig"
osource "/local/mnt/workspace/vede/zephyr/zephyr-fork/zephyr/soc/xlnx/versalnet/Kconfig"
osource "/local/mnt/workspace/vede/zephyr/zephyr-fork/zephyr/soc/xlnx/versal2/Kconfig"
osource "/local/mnt/workspace/vede/zephyr/zephyr-fork/zephyr/soc/xlnx/versal/Kconfig"
osource "/local/mnt/workspace/vede/zephyr/zephyr-fork/zephyr/soc/xen/Kconfig"
osource "/local/mnt/workspace/vede/zephyr/zephyr-fork/zephyr/soc/wch/ch32v/Kconfig"
osource "/local/mnt/workspace/vede/zephyr/zephyr-fork/zephyr/soc/ti/tiva_c/Kconfig"
osource "/local/mnt/workspace/vede/zephyr/zephyr-fork/zephyr/soc/ti/simplelink/Kconfig"
osource "/local/mnt/workspace/vede/zephyr/zephyr-fork/zephyr/soc/ti/mspm/Kconfig"
osource "/local/mnt/workspace/vede/zephyr/zephyr-fork/zephyr/soc/ti/lm3s6965/Kconfig"
osource "/local/mnt/workspace/vede/zephyr/zephyr-fork/zephyr/soc/ti/k3/Kconfig"
osource "/local/mnt/workspace/vede/zephyr/zephyr-fork/zephyr/soc/ti/am13/Kconfig"
osource "/local/mnt/workspace/vede/zephyr/zephyr-fork/zephyr/soc/telink/tlsr/Kconfig"
osource "/local/mnt/workspace/vede/zephyr/zephyr-fork/zephyr/soc/syna/sr100/Kconfig"
osource "/local/mnt/workspace/vede/zephyr/zephyr-fork/zephyr/soc/starfive/jh71xx/Kconfig"
osource "/local/mnt/workspace/vede/zephyr/zephyr-fork/zephyr/soc/st/stm32/Kconfig"
osource "/local/mnt/workspace/vede/zephyr/zephyr-fork/zephyr/soc/snps/qemu_arc/Kconfig"
osource "/local/mnt/workspace/vede/zephyr/zephyr-fork/zephyr/soc/snps/nsim/arc_v/Kconfig"
osource "/local/mnt/workspace/vede/zephyr/zephyr-fork/zephyr/soc/snps/nsim/arc_classic/Kconfig"
osource "/local/mnt/workspace/vede/zephyr/zephyr-fork/zephyr/soc/snps/hsdk4xd/Kconfig"
osource "/local/mnt/workspace/vede/zephyr/zephyr-fork/zephyr/soc/snps/hsdk/Kconfig"
osource "/local/mnt/workspace/vede/zephyr/zephyr-fork/zephyr/soc/snps/emsk/Kconfig"
osource "/local/mnt/workspace/vede/zephyr/zephyr-fork/zephyr/soc/snps/emsdp/Kconfig"
osource "/local/mnt/workspace/vede/zephyr/zephyr-fork/zephyr/soc/snps/arc_iot/Kconfig"
osource "/local/mnt/workspace/vede/zephyr/zephyr-fork/zephyr/soc/silabs/Kconfig"
osource "/local/mnt/workspace/vede/zephyr/zephyr-fork/zephyr/soc/sifli/sf32/Kconfig"
osource "/local/mnt/workspace/vede/zephyr/zephyr-fork/zephyr/soc/sifive/sifive_freedom/Kconfig"
osource "/local/mnt/workspace/vede/zephyr/zephyr-fork/zephyr/soc/shakti/Kconfig"
osource "/local/mnt/workspace/vede/zephyr/zephyr-fork/zephyr/soc/sensry/Kconfig"
osource "/local/mnt/workspace/vede/zephyr/zephyr-fork/zephyr/soc/rockchip/Kconfig"
osource "/local/mnt/workspace/vede/zephyr/zephyr-fork/zephyr/soc/renode/riscv_virtual/Kconfig"
osource "/local/mnt/workspace/vede/zephyr/zephyr-fork/zephyr/soc/renode/cortex_r8_virtual/Kconfig"
osource "/local/mnt/workspace/vede/zephyr/zephyr-fork/zephyr/soc/renesas/smartbond/Kconfig"
osource "/local/mnt/workspace/vede/zephyr/zephyr-fork/zephyr/soc/renesas/rz/Kconfig"
osource "/local/mnt/workspace/vede/zephyr/zephyr-fork/zephyr/soc/renesas/rx/Kconfig"
osource "/local/mnt/workspace/vede/zephyr/zephyr-fork/zephyr/soc/renesas/rcar/Kconfig"
osource "/local/mnt/workspace/vede/zephyr/zephyr-fork/zephyr/soc/renesas/ra/Kconfig"
osource "/local/mnt/workspace/vede/zephyr/zephyr-fork/zephyr/soc/realtek/fingerprint/Kconfig"
osource "/local/mnt/workspace/vede/zephyr/zephyr-fork/zephyr/soc/realtek/ec/Kconfig"
osource "/local/mnt/workspace/vede/zephyr/zephyr-fork/zephyr/soc/realtek/bee/Kconfig"
osource "/local/mnt/workspace/vede/zephyr/zephyr-fork/zephyr/soc/realtek/ameba/Kconfig"
osource "/local/mnt/workspace/vede/zephyr/zephyr-fork/zephyr/soc/raspberrypi/rpi_pico/Kconfig"
osource "/local/mnt/workspace/vede/zephyr/zephyr-fork/zephyr/soc/quicklogic/eos_s3/Kconfig"
osource "/local/mnt/workspace/vede/zephyr/zephyr-fork/zephyr/soc/qemu/virt_riscv/Kconfig"
osource "/local/mnt/workspace/vede/zephyr/zephyr-fork/zephyr/soc/qemu/or1k/Kconfig"
osource "/local/mnt/workspace/vede/zephyr/zephyr-fork/zephyr/soc/qemu/malta/Kconfig"
osource "/local/mnt/workspace/vede/zephyr/zephyr-fork/zephyr/soc/openisa/rv32m1/Kconfig"
osource "/local/mnt/workspace/vede/zephyr/zephyr-fork/zephyr/soc/openhwgroup/cva6/Kconfig"
osource "/local/mnt/workspace/vede/zephyr/zephyr-fork/zephyr/soc/oct/osd32mp15x/Kconfig"
osource "/local/mnt/workspace/vede/zephyr/zephyr-fork/zephyr/soc/nxp/s32/Kconfig"
osource "/local/mnt/workspace/vede/zephyr/zephyr-fork/zephyr/soc/nxp/rw/Kconfig"
osource "/local/mnt/workspace/vede/zephyr/zephyr-fork/zephyr/soc/nxp/mcx/Kconfig"
osource "/local/mnt/workspace/vede/zephyr/zephyr-fork/zephyr/soc/nxp/lpc/Kconfig"
osource "/local/mnt/workspace/vede/zephyr/zephyr-fork/zephyr/soc/nxp/layerscape/Kconfig"
osource "/local/mnt/workspace/vede/zephyr/zephyr-fork/zephyr/soc/nxp/kinetis/Kconfig"
osource "/local/mnt/workspace/vede/zephyr/zephyr-fork/zephyr/soc/nxp/imxrt/Kconfig"
osource "/local/mnt/workspace/vede/zephyr/zephyr-fork/zephyr/soc/nxp/imx/Kconfig"
osource "/local/mnt/workspace/vede/zephyr/zephyr-fork/zephyr/soc/nuvoton/numicro/Kconfig"
osource "/local/mnt/workspace/vede/zephyr/zephyr-fork/zephyr/soc/nuvoton/numaker/Kconfig"
osource "/local/mnt/workspace/vede/zephyr/zephyr-fork/zephyr/soc/nuvoton/npcx/Kconfig"
osource "/local/mnt/workspace/vede/zephyr/zephyr-fork/zephyr/soc/nuvoton/npcm/Kconfig"
osource "/local/mnt/workspace/vede/zephyr/zephyr-fork/zephyr/soc/nordic/Kconfig"
osource "/local/mnt/workspace/vede/zephyr/zephyr-fork/zephyr/soc/neorv32/Kconfig"
osource "/local/mnt/workspace/vede/zephyr/zephyr-fork/zephyr/soc/native/inf_clock/Kconfig"
osource "/local/mnt/workspace/vede/zephyr/zephyr-fork/zephyr/soc/microchip/smartfusion2/Kconfig"
osource "/local/mnt/workspace/vede/zephyr/zephyr-fork/zephyr/soc/microchip/sam/sama7/Kconfig"
osource "/local/mnt/workspace/vede/zephyr/zephyr-fork/zephyr/soc/microchip/sam/sama5/Kconfig"
osource "/local/mnt/workspace/vede/zephyr/zephyr-fork/zephyr/soc/microchip/sam/sam_d5x_e5x/Kconfig"
osource "/local/mnt/workspace/vede/zephyr/zephyr-fork/zephyr/soc/microchip/pic64/Kconfig"
osource "/local/mnt/workspace/vede/zephyr/zephyr-fork/zephyr/soc/microchip/pic32c/pic32cz_ca/Kconfig"
osource "/local/mnt/workspace/vede/zephyr/zephyr-fork/zephyr/soc/microchip/pic32c/pic32cx_sg/Kconfig"
osource "/local/mnt/workspace/vede/zephyr/zephyr-fork/zephyr/soc/microchip/pic32c/pic32cm_sg_gc/Kconfig"
osource "/local/mnt/workspace/vede/zephyr/zephyr-fork/zephyr/soc/microchip/pic32c/pic32cm_pl/Kconfig"
osource "/local/mnt/workspace/vede/zephyr/zephyr-fork/zephyr/soc/microchip/pic32c/pic32cm_jh/Kconfig"
osource "/local/mnt/workspace/vede/zephyr/zephyr-fork/zephyr/soc/microchip/pic32c/pic32ck_sg_gc/Kconfig"
osource "/local/mnt/workspace/vede/zephyr/zephyr-fork/zephyr/soc/microchip/miv/Kconfig"
osource "/local/mnt/workspace/vede/zephyr/zephyr-fork/zephyr/soc/microchip/mec/Kconfig"
osource "/local/mnt/workspace/vede/zephyr/zephyr-fork/zephyr/soc/mediatek/mt8xxx/Kconfig"
osource "/local/mnt/workspace/vede/zephyr/zephyr-fork/zephyr/soc/lowrisc/opentitan/Kconfig"
osource "/local/mnt/workspace/vede/zephyr/zephyr-fork/zephyr/soc/litex/Kconfig"
osource "/local/mnt/workspace/vede/zephyr/zephyr-fork/zephyr/soc/ite/ec/Kconfig"
osource "/local/mnt/workspace/vede/zephyr/zephyr-fork/zephyr/soc/intel/wildcat_lake/Kconfig"
osource "/local/mnt/workspace/vede/zephyr/zephyr-fork/zephyr/soc/intel/raptor_lake/Kconfig"
osource "/local/mnt/workspace/vede/zephyr/zephyr-fork/zephyr/soc/intel/panther_lake/Kconfig"
osource "/local/mnt/workspace/vede/zephyr/zephyr-fork/zephyr/soc/intel/nova_lake/Kconfig"
osource "/local/mnt/workspace/vede/zephyr/zephyr-fork/zephyr/soc/intel/lakemont/Kconfig"
osource "/local/mnt/workspace/vede/zephyr/zephyr-fork/zephyr/soc/intel/intel_socfpga_std/Kconfig"
osource "/local/mnt/workspace/vede/zephyr/zephyr-fork/zephyr/soc/intel/intel_socfpga/Kconfig"
osource "/local/mnt/workspace/vede/zephyr/zephyr-fork/zephyr/soc/intel/intel_niosv/Kconfig"
osource "/local/mnt/workspace/vede/zephyr/zephyr-fork/zephyr/soc/intel/intel_ish/Kconfig"
osource "/local/mnt/workspace/vede/zephyr/zephyr-fork/zephyr/soc/intel/intel_adsp/Kconfig"
osource "/local/mnt/workspace/vede/zephyr/zephyr-fork/zephyr/soc/intel/elkhart_lake/Kconfig"
osource "/local/mnt/workspace/vede/zephyr/zephyr-fork/zephyr/soc/intel/atom/Kconfig"
osource "/local/mnt/workspace/vede/zephyr/zephyr-fork/zephyr/soc/intel/apollo_lake/Kconfig"
osource "/local/mnt/workspace/vede/zephyr/zephyr-fork/zephyr/soc/intel/alder_lake/Kconfig"
osource "/local/mnt/workspace/vede/zephyr/zephyr-fork/zephyr/soc/infineon/psoc4/Kconfig"
osource "/local/mnt/workspace/vede/zephyr/zephyr-fork/zephyr/soc/infineon/edge/Kconfig"
osource "/local/mnt/workspace/vede/zephyr/zephyr-fork/zephyr/soc/infineon/cat3/Kconfig"
osource "/local/mnt/workspace/vede/zephyr/zephyr-fork/zephyr/soc/infineon/cat1c/Kconfig"
osource "/local/mnt/workspace/vede/zephyr/zephyr-fork/zephyr/soc/infineon/cat1b/Kconfig"
osource "/local/mnt/workspace/vede/zephyr/zephyr-fork/zephyr/soc/infineon/cat1a/Kconfig"
osource "/local/mnt/workspace/vede/zephyr/zephyr-fork/zephyr/soc/gd/gd32/Kconfig"
osource "/local/mnt/workspace/vede/zephyr/zephyr-fork/zephyr/soc/gaisler/leon3/Kconfig"
osource "/local/mnt/workspace/vede/zephyr/zephyr-fork/zephyr/soc/gaisler/gr716a/Kconfig"
osource "/local/mnt/workspace/vede/zephyr/zephyr-fork/zephyr/soc/focaltech/Kconfig"
osource "/local/mnt/workspace/vede/zephyr/zephyr-fork/zephyr/soc/espressif/Kconfig"
osource "/local/mnt/workspace/vede/zephyr/zephyr-fork/zephyr/soc/ene/kb1200/Kconfig"
osource "/local/mnt/workspace/vede/zephyr/zephyr-fork/zephyr/soc/ene/kb106x/Kconfig"
osource "/local/mnt/workspace/vede/zephyr/zephyr-fork/zephyr/soc/elan/em32f967/Kconfig"
osource "/local/mnt/workspace/vede/zephyr/zephyr-fork/zephyr/soc/egis/Kconfig"
osource "/local/mnt/workspace/vede/zephyr/zephyr-fork/zephyr/soc/efinix/sapphire/Kconfig"
osource "/local/mnt/workspace/vede/zephyr/zephyr-fork/zephyr/soc/cdns/xtensa_sample_controller/Kconfig"
osource "/local/mnt/workspace/vede/zephyr/zephyr-fork/zephyr/soc/cdns/swerv/Kconfig"
osource "/local/mnt/workspace/vede/zephyr/zephyr-fork/zephyr/soc/cdns/sample_controller32/Kconfig"
osource "/local/mnt/workspace/vede/zephyr/zephyr-fork/zephyr/soc/cdns/dc233c/Kconfig"
osource "/local/mnt/workspace/vede/zephyr/zephyr-fork/zephyr/soc/brcm/bcmvk/Kconfig"
osource "/local/mnt/workspace/vede/zephyr/zephyr-fork/zephyr/soc/brcm/bcm2712/Kconfig"
osource "/local/mnt/workspace/vede/zephyr/zephyr-fork/zephyr/soc/brcm/bcm2711/Kconfig"
osource "/local/mnt/workspace/vede/zephyr/zephyr-fork/zephyr/soc/brcm/bcm2710/Kconfig"
osource "/local/mnt/workspace/vede/zephyr/zephyr-fork/zephyr/soc/blackberry/qnxhv_vm/Kconfig"
osource "/local/mnt/workspace/vede/zephyr/zephyr-fork/zephyr/soc/bflb/Kconfig"
osource "/local/mnt/workspace/vede/zephyr/zephyr-fork/zephyr/soc/atmel/sam0/Kconfig"
osource "/local/mnt/workspace/vede/zephyr/zephyr-fork/zephyr/soc/atmel/sam/Kconfig"
osource "/local/mnt/workspace/vede/zephyr/zephyr-fork/zephyr/soc/aspeed/Kconfig"
osource "/local/mnt/workspace/vede/zephyr/zephyr-fork/zephyr/soc/arm/Kconfig"
osource "/local/mnt/workspace/vede/zephyr/zephyr-fork/zephyr/soc/antmicro/myra/Kconfig"
osource "/local/mnt/workspace/vede/zephyr/zephyr-fork/zephyr/soc/andestech/Kconfig"
osource "/local/mnt/workspace/vede/zephyr/zephyr-fork/zephyr/soc/amd/acp_7_x/Kconfig"
osource "/local/mnt/workspace/vede/zephyr/zephyr-fork/zephyr/soc/amd/acp_7_0/Kconfig"
osource "/local/mnt/workspace/vede/zephyr/zephyr-fork/zephyr/soc/amd/acp_6_0/Kconfig"
osource "/local/mnt/workspace/vede/zephyr/zephyr-fork/zephyr/soc/ambiq/Kconfig"
osource "/local/mnt/workspace/vede/zephyr/zephyr-fork/zephyr/soc/allwinner/sun8i_h3/Kconfig"
osource "/local/mnt/workspace/vede/zephyr/zephyr-fork/zephyr/soc/allwinner/sun50i_h618/Kconfig"
osource "/local/mnt/workspace/vede/zephyr/zephyr-fork/zephyr/soc/alif/ensemble/Kconfig"
osource "/local/mnt/workspace/vede/zephyr/zephyr-fork/zephyr/soc/alif/balletto/Kconfig"
osource "/local/mnt/workspace/vede/zephyr/zephyr-fork/zephyr/soc/aesc/Kconfig"
osource "/local/mnt/workspace/vede/zephyr/zephyr-fork/zephyr/soc/adi/max32/Kconfig"
```
