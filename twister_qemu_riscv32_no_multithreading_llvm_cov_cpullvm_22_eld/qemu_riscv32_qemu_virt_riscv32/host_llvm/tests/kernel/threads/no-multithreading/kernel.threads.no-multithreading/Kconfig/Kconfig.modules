## twister_qemu_riscv32_no_multithreading_llvm_cov_cpullvm_22_eld/qemu_riscv32_qemu_virt_riscv32/host_llvm/tests/kernel/threads/no-multithreading/kernel.threads.no-multithreading/Kconfig/Kconfig.modules
```kconfig
menu "acpica (/local/mnt/workspace/vede/zephyr/zephyr-fork/modules/lib/acpica)"
osource "$(ZEPHYR_ACPICA_KCONFIG)"
config ZEPHYR_ACPICA_MODULE
	bool
	default y
endmenu
menu "cmsis (/local/mnt/workspace/vede/zephyr/zephyr-fork/modules/hal/cmsis)"
osource "$(ZEPHYR_CMSIS_KCONFIG)"
config ZEPHYR_CMSIS_MODULE
	bool
	default y
endmenu
menu "cmsis-dsp (/local/mnt/workspace/vede/zephyr/zephyr-fork/modules/lib/cmsis-dsp)"
osource "/local/mnt/workspace/vede/zephyr/zephyr-fork/modules/lib/cmsis-dsp/zephyr/Kconfig"
config ZEPHYR_CMSIS_DSP_MODULE
	bool
	default y
endmenu
menu "cmsis-nn (/local/mnt/workspace/vede/zephyr/zephyr-fork/modules/lib/cmsis-nn)"
osource "$(ZEPHYR_CMSIS_NN_KCONFIG)"
config ZEPHYR_CMSIS_NN_MODULE
	bool
	default y
endmenu
menu "cmsis_6 (/local/mnt/workspace/vede/zephyr/zephyr-fork/modules/hal/cmsis_6)"
osource "$(ZEPHYR_CMSIS_6_KCONFIG)"
config ZEPHYR_CMSIS_6_MODULE
	bool
	default y
endmenu
menu "dhara (/local/mnt/workspace/vede/zephyr/zephyr-fork/modules/lib/dhara)"
osource "$(ZEPHYR_DHARA_KCONFIG)"
config ZEPHYR_DHARA_MODULE
	bool
	default y
endmenu
menu "fatfs (/local/mnt/workspace/vede/zephyr/zephyr-fork/modules/fs/fatfs)"
osource "$(ZEPHYR_FATFS_KCONFIG)"
config ZEPHYR_FATFS_MODULE
	bool
	default y
endmenu
config ZEPHYR_ADI_MODULE
	bool
	default y
menu "hal_afbr (/local/mnt/workspace/vede/zephyr/zephyr-fork/modules/hal/afbr)"
osource "$(ZEPHYR_HAL_AFBR_KCONFIG)"
config ZEPHYR_HAL_AFBR_MODULE
	bool
	default y

config ZEPHYR_HAL_AFBR_MODULE_BLOBS
	bool
endmenu
menu "hal_ambiq (/local/mnt/workspace/vede/zephyr/zephyr-fork/modules/hal/ambiq)"
osource "$(ZEPHYR_HAL_AMBIQ_KCONFIG)"
config ZEPHYR_HAL_AMBIQ_MODULE
	bool
	default y
endmenu
config ZEPHYR_ATMEL_MODULE
	bool
	default y
menu "hal_bouffalolab (/local/mnt/workspace/vede/zephyr/zephyr-fork/modules/hal/bouffalolab)"
osource "$(ZEPHYR_HAL_BOUFFALOLAB_KCONFIG)"
config ZEPHYR_HAL_BOUFFALOLAB_MODULE
	bool
	default y

config ZEPHYR_HAL_BOUFFALOLAB_MODULE_BLOBS
	bool
endmenu
menu "hal_espressif (/local/mnt/workspace/vede/zephyr/zephyr-fork/modules/hal/espressif)"
osource "/local/mnt/workspace/vede/zephyr/zephyr-fork/modules/hal/espressif/zephyr/Kconfig"
config ZEPHYR_HAL_ESPRESSIF_MODULE
	bool
	default y

config ZEPHYR_HAL_ESPRESSIF_MODULE_BLOBS
	bool
endmenu
menu "hal_ethos_u (/local/mnt/workspace/vede/zephyr/zephyr-fork/modules/hal/ethos_u)"
osource "$(ZEPHYR_HAL_ETHOS_U_KCONFIG)"
config ZEPHYR_HAL_ETHOS_U_MODULE
	bool
	default y
endmenu
menu "hal_gigadevice (/local/mnt/workspace/vede/zephyr/zephyr-fork/modules/hal/gigadevice)"
osource "$(ZEPHYR_HAL_GIGADEVICE_KCONFIG)"
config ZEPHYR_HAL_GIGADEVICE_MODULE
	bool
	default y
endmenu
menu "hal_infineon (/local/mnt/workspace/vede/zephyr/zephyr-fork/modules/hal/infineon)"
osource "$(ZEPHYR_HAL_INFINEON_KCONFIG)"
config ZEPHYR_HAL_INFINEON_MODULE
	bool
	default y

config ZEPHYR_HAL_INFINEON_MODULE_BLOBS
	bool
endmenu
menu "hal_intel (/local/mnt/workspace/vede/zephyr/zephyr-fork/modules/hal/intel)"
osource "/local/mnt/workspace/vede/zephyr/zephyr-fork/modules/hal/intel/zephyr/Kconfig"
config ZEPHYR_HAL_INTEL_MODULE
	bool
	default y
endmenu
config ZEPHYR_HAL_MICROCHIP_MODULE
	bool
	default y

config ZEPHYR_HAL_MICROCHIP_MODULE_BLOBS
	bool
menu "hal_nordic (/local/mnt/workspace/vede/zephyr/zephyr-fork/modules/hal/nordic)"
osource "$(ZEPHYR_HAL_NORDIC_KCONFIG)"
config ZEPHYR_HAL_NORDIC_MODULE
	bool
	default y

config ZEPHYR_HAL_NORDIC_MODULE_BLOBS
	bool
endmenu
config ZEPHYR_NUVOTON_MODULE
	bool
	default y
menu "hal_nxp (/local/mnt/workspace/vede/zephyr/zephyr-fork/modules/hal/nxp)"
osource "$(ZEPHYR_HAL_NXP_KCONFIG)"
config ZEPHYR_HAL_NXP_MODULE
	bool
	default y

config ZEPHYR_HAL_NXP_MODULE_BLOBS
	bool
endmenu
config ZEPHYR_OPENISA_MODULE
	bool
	default y
config ZEPHYR_QUICKLOGIC_MODULE
	bool
	default y
menu "hal_realtek (/local/mnt/workspace/vede/zephyr/zephyr-fork/modules/hal/realtek)"
osource "$(ZEPHYR_HAL_REALTEK_KCONFIG)"
config ZEPHYR_HAL_REALTEK_MODULE
	bool
	default y

config ZEPHYR_HAL_REALTEK_MODULE_BLOBS
	bool
endmenu
config ZEPHYR_HAL_RENESAS_MODULE
	bool
	default y

config ZEPHYR_HAL_RENESAS_MODULE_BLOBS
	bool
menu "hal_rpi_pico (/local/mnt/workspace/vede/zephyr/zephyr-fork/modules/hal/rpi_pico)"
osource "$(ZEPHYR_HAL_RPI_PICO_KCONFIG)"
config ZEPHYR_HAL_RPI_PICO_MODULE
	bool
	default y
endmenu
menu "hal_sifli (/local/mnt/workspace/vede/zephyr/zephyr-fork/modules/hal/sifli)"
osource "$(ZEPHYR_HAL_SIFLI_KCONFIG)"
config ZEPHYR_HAL_SIFLI_MODULE
	bool
	default y

config ZEPHYR_HAL_SIFLI_MODULE_BLOBS
	bool
endmenu
menu "hal_silabs (/local/mnt/workspace/vede/zephyr/zephyr-fork/modules/hal/silabs)"
osource "$(ZEPHYR_HAL_SILABS_KCONFIG)"
config ZEPHYR_HAL_SILABS_MODULE
	bool
	default y

config ZEPHYR_HAL_SILABS_MODULE_BLOBS
	bool
endmenu
menu "hal_st (/local/mnt/workspace/vede/zephyr/zephyr-fork/modules/hal/st)"
osource "$(ZEPHYR_HAL_ST_KCONFIG)"
config ZEPHYR_HAL_ST_MODULE
	bool
	default y
endmenu
config ZEPHYR_HAL_STM32_MODULE
	bool
	default y

config ZEPHYR_HAL_STM32_MODULE_BLOBS
	bool
menu "hal_tdk (/local/mnt/workspace/vede/zephyr/zephyr-fork/modules/hal/tdk)"
osource "$(ZEPHYR_HAL_TDK_KCONFIG)"
config ZEPHYR_HAL_TDK_MODULE
	bool
	default y
endmenu
menu "hal_telink (/local/mnt/workspace/vede/zephyr/zephyr-fork/modules/hal/telink)"
osource "/local/mnt/workspace/vede/zephyr/zephyr-fork/modules/hal/telink/Kconfig"
config ZEPHYR_HAL_TELINK_MODULE
	bool
	default y
endmenu
config ZEPHYR_TI_MODULE
	bool
	default y
menu "hal_wch (/local/mnt/workspace/vede/zephyr/zephyr-fork/modules/hal/wch)"
osource "$(ZEPHYR_HAL_WCH_KCONFIG)"
config ZEPHYR_HAL_WCH_MODULE
	bool
	default y
endmenu
config ZEPHYR_HAL_WURTHELEKTRONIK_MODULE
	bool
	default y
config ZEPHYR_XTENSA_MODULE
	bool
	default y
menu "hostap (/local/mnt/workspace/vede/zephyr/zephyr-fork/modules/lib/hostap)"
osource "$(ZEPHYR_HOSTAP_KCONFIG)"
config ZEPHYR_HOSTAP_MODULE
	bool
	default y
endmenu
menu "liblc3 (/local/mnt/workspace/vede/zephyr/zephyr-fork/modules/lib/liblc3)"
osource "$(ZEPHYR_LIBLC3_KCONFIG)"
config ZEPHYR_LIBLC3_MODULE
	bool
	default y
endmenu
config ZEPHYR_LIBMCTP_MODULE
	bool
	default y
config ZEPHYR_LIBMETAL_MODULE
	bool
	default y
menu "libsbc (/local/mnt/workspace/vede/zephyr/zephyr-fork/modules/lib/libsbc)"
osource "$(ZEPHYR_LIBSBC_KCONFIG)"
config ZEPHYR_LIBSBC_MODULE
	bool
	default y
endmenu
menu "littlefs (/local/mnt/workspace/vede/zephyr/zephyr-fork/modules/fs/littlefs)"
osource "$(ZEPHYR_LITTLEFS_KCONFIG)"
config ZEPHYR_LITTLEFS_MODULE
	bool
	default y
endmenu
menu "lora-basics-modem (/local/mnt/workspace/vede/zephyr/zephyr-fork/modules/lib/lora-basics-modem)"
osource "$(ZEPHYR_LORA_BASICS_MODEM_KCONFIG)"
config ZEPHYR_LORA_BASICS_MODEM_MODULE
	bool
	default y
endmenu
menu "loramac-node (/local/mnt/workspace/vede/zephyr/zephyr-fork/modules/lib/loramac-node)"
osource "$(ZEPHYR_LORAMAC_NODE_KCONFIG)"
config ZEPHYR_LORAMAC_NODE_MODULE
	bool
	default y
endmenu
menu "lvgl (/local/mnt/workspace/vede/zephyr/zephyr-fork/modules/lib/gui/lvgl)"
osource "/local/mnt/workspace/vede/zephyr/zephyr-fork/modules/lib/gui/lvgl/zephyr/Kconfig"
config ZEPHYR_LVGL_MODULE
	bool
	default y
endmenu
menu "mbedtls (/local/mnt/workspace/vede/zephyr/zephyr-fork/modules/crypto/mbedtls)"
osource "$(ZEPHYR_MBEDTLS_KCONFIG)"
config ZEPHYR_MBEDTLS_MODULE
	bool
	default y
endmenu
config ZEPHYR_MCUBOOT_MODULE
	bool
	default y
config ZEPHYR_MIPI_SYS_T_MODULE
	bool
	default y
config ZEPHYR_MLDSA_NATIVE_MODULE
	bool
	default y
menu "nanopb (/local/mnt/workspace/vede/zephyr/zephyr-fork/modules/lib/nanopb)"
osource "$(ZEPHYR_NANOPB_KCONFIG)"
config ZEPHYR_NANOPB_MODULE
	bool
	default y
endmenu
menu "nrf_wifi (/local/mnt/workspace/vede/zephyr/zephyr-fork/modules/lib/nrf_wifi)"
osource "$(ZEPHYR_NRF_WIFI_KCONFIG)"
config ZEPHYR_NRF_WIFI_MODULE
	bool
	default y

config ZEPHYR_NRF_WIFI_MODULE_BLOBS
	bool
endmenu
config ZEPHYR_OPEN_AMP_MODULE
	bool
	default y
menu "openthread (/local/mnt/workspace/vede/zephyr/zephyr-fork/modules/lib/openthread)"
osource "$(ZEPHYR_OPENTHREAD_KCONFIG)"
config ZEPHYR_OPENTHREAD_MODULE
	bool
	default y
endmenu
menu "percepio (/local/mnt/workspace/vede/zephyr/zephyr-fork/modules/debug/percepio)"
osource "/local/mnt/workspace/vede/zephyr/zephyr-fork/modules/debug/percepio/zephyr/Kconfig"
config ZEPHYR_PERCEPIO_MODULE
	bool
	default y
endmenu
menu "picolibc (/local/mnt/workspace/vede/zephyr/zephyr-fork/modules/lib/picolibc)"
osource "/local/mnt/workspace/vede/zephyr/zephyr-fork/modules/lib/picolibc/zephyr/Kconfig"
config ZEPHYR_PICOLIBC_MODULE
	bool
	default y
endmenu
config ZEPHYR_PSA_ARCH_TESTS_MODULE
	bool
	default y
config ZEPHYR_REQMGMT_MODULE
	bool
	default y
menu "segger (/local/mnt/workspace/vede/zephyr/zephyr-fork/modules/debug/segger)"
osource "$(ZEPHYR_SEGGER_KCONFIG)"
config ZEPHYR_SEGGER_MODULE
	bool
	default y
endmenu
config ZEPHYR_TF_M_TESTS_MODULE
	bool
	default y
config ZEPHYR_TF_PSA_CRYPTO_MODULE
	bool
	default y
menu "trusted-firmware-a (/local/mnt/workspace/vede/zephyr/zephyr-fork/modules/tee/tf-a/trusted-firmware-a)"
osource "$(ZEPHYR_TRUSTED_FIRMWARE_A_KCONFIG)"
config ZEPHYR_TRUSTED_FIRMWARE_A_MODULE
	bool
	default y
endmenu
menu "trusted-firmware-m (/local/mnt/workspace/vede/zephyr/zephyr-fork/modules/tee/tf-m/trusted-firmware-m)"
osource "$(ZEPHYR_TRUSTED_FIRMWARE_M_KCONFIG)"
config ZEPHYR_TRUSTED_FIRMWARE_M_MODULE
	bool
	default y
endmenu
menu "uoscore-uedhoc (/local/mnt/workspace/vede/zephyr/zephyr-fork/modules/lib/uoscore-uedhoc)"
osource "$(ZEPHYR_UOSCORE_UEDHOC_KCONFIG)"
config ZEPHYR_UOSCORE_UEDHOC_MODULE
	bool
	default y
endmenu
menu "zcbor (/local/mnt/workspace/vede/zephyr/zephyr-fork/modules/lib/zcbor)"
osource "$(ZEPHYR_ZCBOR_KCONFIG)"
config ZEPHYR_ZCBOR_MODULE
	bool
	default y
endmenu
menu "xenlib (/local/mnt/workspace/vede/zephyr/zephyr-fork/modules/lib/zephyr-xenlib)"
osource "/local/mnt/workspace/vede/zephyr/zephyr-fork/modules/lib/zephyr-xenlib/Kconfig"
config ZEPHYR_XENLIB_MODULE
	bool
	default y
endmenu
config ZEPHYR_NRF_HW_MODELS_MODULE
	bool
	default y
```

## twister_qemu_riscv32_no_multithreading_llvm_cov_cpullvm_22_eld/qemu_riscv32_qemu_virt_riscv32/host_llvm/tests/kernel/threads/no-multithreading/kernel.threads.no-multithreading/Kconfig/arch/Kconfig
```kconfig
# Load Zephyr Arch Kconfig descriptions.
osource "/local/mnt/workspace/vede/zephyr/zephyr-fork/zephyr/arch/rx/Kconfig"
osource "/local/mnt/workspace/vede/zephyr/zephyr-fork/zephyr/arch/x86/Kconfig"
osource "/local/mnt/workspace/vede/zephyr/zephyr-fork/zephyr/arch/xtensa/Kconfig"
osource "/local/mnt/workspace/vede/zephyr/zephyr-fork/zephyr/arch/sparc/Kconfig"
osource "/local/mnt/workspace/vede/zephyr/zephyr-fork/zephyr/arch/riscv/Kconfig"
osource "/local/mnt/workspace/vede/zephyr/zephyr-fork/zephyr/arch/posix/Kconfig"
osource "/local/mnt/workspace/vede/zephyr/zephyr-fork/zephyr/arch/openrisc/Kconfig"
osource "/local/mnt/workspace/vede/zephyr/zephyr-fork/zephyr/arch/mips/Kconfig"
osource "/local/mnt/workspace/vede/zephyr/zephyr-fork/zephyr/arch/arm64/Kconfig"
osource "/local/mnt/workspace/vede/zephyr/zephyr-fork/zephyr/arch/arm/Kconfig"
osource "/local/mnt/workspace/vede/zephyr/zephyr-fork/zephyr/arch/arc/Kconfig"
```

## twister_qemu_riscv32_no_multithreading_llvm_cov_cpullvm_22_eld/qemu_riscv32_qemu_virt_riscv32/host_llvm/tests/kernel/threads/no-multithreading/kernel.threads.no-multithreading/Kconfig/boards/Kconfig
```kconfig
# Load Zephyr board Kconfig descriptions.
osource "/local/mnt/workspace/vede/zephyr/zephyr-fork/zephyr/boards/qemu/riscv32/Kconfig"
```

## twister_qemu_riscv32_no_multithreading_llvm_cov_cpullvm_22_eld/qemu_riscv32_qemu_virt_riscv32/host_llvm/tests/kernel/threads/no-multithreading/kernel.threads.no-multithreading/Kconfig/boards/Kconfig.defconfig
```kconfig
# Load Zephyr board defconfig descriptions.
osource "/local/mnt/workspace/vede/zephyr/zephyr-fork/zephyr/boards/qemu/riscv32/Kconfig.defconfig"
```
